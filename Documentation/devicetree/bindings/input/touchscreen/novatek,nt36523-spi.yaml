## Documentation/devicetree/bindings/power/supply/qcom,pmi8998-charger.yaml
```yaml
# SPDX-License-Identifier: GPL-2.0 OR BSD-2-Clause
%YAML 1.2
---
$id: http://devicetree.org/schemas/power/supply/qcom,pmi8998-charger.yaml#
$schema: http://devicetree.org/meta-schemas/core.yaml#

title: Qualcomm PMI8998/PM660 Switch-Mode Battery Charger "2"

maintainers:
  - Casey Connolly <casey.connolly@linaro.org>

properties:
  compatible:
    enum:
      - qcom,pm7250b-charger
      - qcom,pm8150b-charger
      - qcom,pmi8998-charger
      - qcom,pm660-charger

  reg:
    maxItems: 1

  interrupts:
    maxItems: 4

  interrupt-names:
    items:
      - const: usb-plugin
      - const: bat-ov
      - const: wdog-bark
      - const: usbin-icl-change

  io-channels:
    minItems: 2
    items:
      - description: USB in current in uA
      - description: USB in voltage in uV
      - description: Optional USB connector thermistor temperature in millicelsius

  io-channel-names:
    minItems: 2
    items:
      - const: usbin_i
      - const: usbin_v
      - const: connector_temp

  monitored-battery: true

  input-power-supply:
    description:
      TCPM power supply used to obtain the negotiated USB current, voltage and
      USB Power Delivery type.

  '#cooling-cells':
    const: 2
    description:
      The first cell is the minimum cooling state and the second cell is the
      maximum cooling state. Higher states select lower charge-current limits.

  qcom,thermal-mitigation-microamp:
    minItems: 1
    maxItems: 32
    items:
      minimum: 0
    description:
      Descending fast-charge-current limits, one for each cooling state.

  qcom,thermal-mitigation-input-microamp:
    minItems: 1
    maxItems: 32
    items:
      minimum: 0
    description:
      Descending USB input-current limits. The number of entries must match
      qcom,thermal-mitigation-microamp.

  qcom,thermal-mitigation-dcp-microamp:
    minItems: 1
    maxItems: 32
    items:
      minimum: 0
    description:
      Optional descending DCP-specific USB input-current limits. The number of
      entries must match qcom,thermal-mitigation-microamp.

  qcom,thermal-mitigation-pd-microamp:
    minItems: 1
    maxItems: 32
    items:
      minimum: 0
    description:
      Optional descending 5 V PD base input-current limits. For higher fixed
      PDO voltages the driver scales these limits to maintain a conservative
      power ceiling. The number of entries must match
      qcom,thermal-mitigation-microamp.

  qcom,jeita-ranges:
    $ref: /schemas/types.yaml#/definitions/uint32-array
    minItems: 4
    maxItems: 32
    description:
      Battery-profile JEITA tuples containing minimum temperature in
      decidegrees Celsius, maximum temperature in decidegrees Celsius,
      charge-current limit in microamps and float-voltage limit in microvolts.
      Temperature cells use signed two's-complement values. Ranges must be
      sorted, non-overlapping and contain four cells each.

required:
  - compatible
  - reg
  - interrupts
  - interrupt-names
  - io-channels
  - io-channel-names
  - monitored-battery

dependencies:
  qcom,thermal-mitigation-microamp:
    - '#cooling-cells'
    - qcom,thermal-mitigation-input-microamp
  qcom,thermal-mitigation-input-microamp:
    - '#cooling-cells'
    - qcom,thermal-mitigation-microamp
  qcom,thermal-mitigation-dcp-microamp:
    - qcom,thermal-mitigation-microamp
    - qcom,thermal-mitigation-input-microamp
  qcom,thermal-mitigation-pd-microamp:
    - input-power-supply
    - qcom,thermal-mitigation-microamp
    - qcom,thermal-mitigation-input-microamp

allOf:
  - $ref: power-supply.yaml#

additionalProperties: false

examples:
  - |
    #include <dt-bindings/interrupt-controller/irq.h>

    pmic {
      #address-cells = <1>;
      #size-cells = <0>;

      charger@1000 {
        compatible = "qcom,pmi8998-charger";
        reg = <0x1000>;

        interrupts = <0x2 0x12 0x2 IRQ_TYPE_EDGE_BOTH>,
                     <0x2 0x13 0x4 IRQ_TYPE_EDGE_BOTH>,
                     <0x2 0x13 0x6 IRQ_TYPE_EDGE_RISING>,
                     <0x2 0x16 0x1 IRQ_TYPE_EDGE_RISING>;
        interrupt-names = "usb-plugin", "bat-ov", "wdog-bark", "usbin-icl-change";

        io-channels = <&pmi8998_rradc 3>,
                      <&pmi8998_rradc 4>;
        io-channel-names = "usbin_i",
                           "usbin_v";

        monitored-battery = <&battery>;

        #cooling-cells = <2>;
        qcom,thermal-mitigation-microamp = <1500000 1000000 500000>;
        qcom,thermal-mitigation-input-microamp = <1500000 1000000 500000>;
        qcom,jeita-ranges = <0 150 820000 4150000
                            151 450 1500000 4400000
                            451 550 820000 4150000>;
      };
    };
```

## Documentation/devicetree/bindings/soc/qcom/qcom,smp2p-sleep-state.yaml
```yaml
# SPDX-License-Identifier: (GPL-2.0-only OR BSD-2-Clause)
%YAML 1.2
---
$id: http://devicetree.org/schemas/soc/qcom/qcom,smp2p-sleep-state.yaml#
$schema: http://devicetree.org/meta-schemas/core.yaml#

title: Qualcomm SMP2P application processor sleep state

maintainers:
  - MCC45TR <mursitcancihan@gmail.com>

description:
  Publishes application-processor awake state to Qualcomm remote firmware and
  receives the corresponding state-change interrupt. Some downstream sensor
  firmware requires this handshake around system suspend.

properties:
  compatible:
    const: qcom,smp2p-sleep-state

  qcom,smem-states:
    $ref: /schemas/types.yaml#/definitions/phandle-array
    maxItems: 1

  interrupt-parent: true

  interrupts:
    maxItems: 1

  interrupt-names:
    const: state-change

required:
  - compatible
  - qcom,smem-states
  - interrupts
  - interrupt-names

additionalProperties: false

examples:
  - |
    sleep-state {
        compatible = "qcom,smp2p-sleep-state";
        qcom,smem-states = <&sleepstate_out 0>;
        interrupt-parent = <&sleepstate_in>;
        interrupts = <0 1>;
        interrupt-names = "state-change";
    };
```
