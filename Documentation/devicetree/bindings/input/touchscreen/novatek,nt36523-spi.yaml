## Documentation/devicetree/bindings/input/touchscreen/novatek,nt36523-spi.yaml
```yaml
# SPDX-License-Identifier: (GPL-2.0-only OR BSD-2-Clause)
%YAML 1.2
---
$id: http://devicetree.org/schemas/input/touchscreen/novatek,nt36523-spi.yaml#
$schema: http://devicetree.org/meta-schemas/core.yaml#

title: Novatek NT36523 SPI touchscreen controller

maintainers:
  - Senemos Nabu Kernel Team <mcc45tr@users.noreply.github.com>

allOf:
  - $ref: touchscreen.yaml#
  - $ref: /schemas/spi/spi-peripheral-props.yaml#

properties:
  compatible:
    const: novatek,nt36523-spi

  reg:
    maxItems: 1

  spi-max-frequency:
    maximum: 9600000

  irq-gpios:
    maxItems: 1

  firmware-name:
    maxItems: 1

  novatek,pen-support:
    type: boolean
    description: Enable the controller's active-pen input path.

  novatek,wgp-stylus:
    type: boolean
    description: Enable Novatek WGP stylus protocol support.

  novatek,double-tap-to-wake:
    type: boolean
    description: Keep gesture detection armed for double-tap wake.

  novatek,swrst-n8-addr:
    $ref: /schemas/types.yaml#/definitions/uint32
    description: Controller software-reset register address.

  novatek,spi-rd-fast-addr:
    $ref: /schemas/types.yaml#/definitions/uint32
    description: Optional fast SPI-read command register address.

  wakeup-source: true

required:
  - compatible
  - reg
  - spi-max-frequency
  - irq-gpios
  - firmware-name
  - novatek,swrst-n8-addr

unevaluatedProperties: false

examples:
  - |
    #include <dt-bindings/gpio/gpio.h>

    spi {
        #address-cells = <1>;
        #size-cells = <0>;

        touchscreen@0 {
            compatible = "novatek,nt36523-spi";
            reg = <0>;
            spi-max-frequency = <9600000>;
            irq-gpios = <&tlmm 39 GPIO_ACTIVE_LOW>;
            firmware-name = "novatek/novatek_nt36523_fw.bin";
            novatek,swrst-n8-addr = <0x03f0fe>;
        };
    };
...
```

## Documentation/devicetree/bindings/input/xiaomi,nabu-keyboard.yaml
```yaml
# SPDX-License-Identifier: (GPL-2.0-only OR BSD-2-Clause)
%YAML 1.2
---
$id: http://devicetree.org/schemas/input/xiaomi,nabu-keyboard.yaml#
$schema: http://devicetree.org/meta-schemas/core.yaml#

title: Xiaomi Pad 5 pogo keyboard-cover controller

maintainers:
  - MCC45TR <mcc45tr@users.noreply.github.com>

description: |
  The Xiaomi Pad 5 contains a USB keyboard controller whose power, reset and
  physical cover-detect signals are wired to TLMM GPIOs. The controller
  powers the keyboard cover through its pogo connector.

properties:
  compatible:
    const: xiaomi,nabu-keyboard

  vdd-gpios:
    maxItems: 1

  reset-gpios:
    maxItems: 1

  detect-gpios:
    maxItems: 1

  pinctrl-names:
    items:
      - const: default
      - const: sleep

  pinctrl-0: true
  pinctrl-1: true
  wakeup-source: true

required:
  - compatible
  - vdd-gpios
  - reset-gpios
  - detect-gpios

additionalProperties: false

examples:
  - |
    #include <dt-bindings/gpio/gpio.h>

    keyboard-cover {
        compatible = "xiaomi,nabu-keyboard";
        vdd-gpios = <&tlmm 82 GPIO_ACTIVE_HIGH>;
        reset-gpios = <&tlmm 49 GPIO_ACTIVE_LOW>;
        detect-gpios = <&tlmm 41 GPIO_ACTIVE_LOW>;
        wakeup-source;
    };
```

## Documentation/devicetree/bindings/media/i2c/ovti,ov13b10.yaml
```yaml
# SPDX-License-Identifier: (GPL-2.0-only OR BSD-2-Clause)
%YAML 1.2
---
$id: http://devicetree.org/schemas/media/i2c/ovti,ov13b10.yaml#
$schema: http://devicetree.org/meta-schemas/core.yaml#

title: OmniVision OV13B10 CMOS sensor

maintainers:
  - Arec Kao <arec.kao@intel.com>

allOf:
  - $ref: /schemas/media/video-interface-devices.yaml#

properties:
  compatible:
    const: ovti,ov13b10

  reg:
    maxItems: 1

  clocks:
    description: External clock.
    maxItems: 1

  clock-frequency:
    const: 19200000

  reset-gpios:
    description: GPIO connected to the active-low XSHUTDOWN input.
    maxItems: 1

  avdd-supply:
    description: Analog circuit voltage supply.

  dvdd-supply:
    description: Digital core voltage supply.

  dovdd-supply:
    description: Digital I/O voltage supply.

  port:
    $ref: /schemas/graph.yaml#/$defs/port-base
    additionalProperties: false

    properties:
      endpoint:
        $ref: /schemas/media/video-interfaces.yaml#
        unevaluatedProperties: false

        properties:
          data-lanes:
            minItems: 2
            maxItems: 4

        required:
          - data-lanes
          - link-frequencies

required:
  - compatible
  - reg
  - clocks
  - clock-frequency
  - reset-gpios
  - avdd-supply
  - dvdd-supply
  - dovdd-supply
  - port

unevaluatedProperties: false

examples:
  - |
    #include <dt-bindings/gpio/gpio.h>

    i2c {
        #address-cells = <1>;
        #size-cells = <0>;

        camera@36 {
            compatible = "ovti,ov13b10";
            reg = <0x36>;
            clocks = <&sensor_clk>;
            clock-frequency = <19200000>;
            reset-gpios = <&gpio 28 GPIO_ACTIVE_LOW>;
            avdd-supply = <&camera_avdd>;
            dvdd-supply = <&camera_dvdd>;
            dovdd-supply = <&camera_dovdd>;

            port {
                endpoint {
                    data-lanes = <1 2 3 4>;
                    link-frequencies = /bits/ 64 <560000000>;
                };
            };
        };
    };
...
```

## Documentation/devicetree/bindings/media/qcom,sm8150-camss.yaml
```yaml
# SPDX-License-Identifier: (GPL-2.0 OR BSD-2-Clause)
%YAML 1.2
---
$id: http://devicetree.org/schemas/media/qcom,sm8150-camss.yaml#
$schema: http://devicetree.org/meta-schemas/core.yaml#

title: Qualcomm SM8150 Camera Subsystem

maintainers:
  - Robert Foss <rfoss@kernel.org>

description: |
  The SM8150 CAMSS contains four CSI PHYs, two CSI decoders and two
  Image Front Ends. This binding describes the two full IFE paths used by
  board camera sensors; the two lite paths are outside this initial support.

properties:
  compatible:
    const: qcom,sm8150-camss

  clocks:
    minItems: 31
    maxItems: 31

  clock-names:
    items:
      - const: camnoc_axi
      - const: cpas_ahb
      - const: cphy_rx_src
      - const: csi0
      - const: csi0_src
      - const: csi1
      - const: csi1_src
      - const: csiphy0
      - const: csiphy0_timer
      - const: csiphy0_timer_src
      - const: csiphy1
      - const: csiphy1_timer
      - const: csiphy1_timer_src
      - const: csiphy2
      - const: csiphy2_timer
      - const: csiphy2_timer_src
      - const: csiphy3
      - const: csiphy3_timer
      - const: csiphy3_timer_src
      - const: gcc_camera_ahb
      - const: gcc_camera_axi
      - const: slow_ahb_src
      - const: soc_ahb
      - const: vfe0
      - const: vfe0_axi
      - const: vfe0_cphy_rx
      - const: vfe0_src
      - const: vfe1
      - const: vfe1_axi
      - const: vfe1_cphy_rx
      - const: vfe1_src

  interconnects:
    minItems: 3
    maxItems: 3

  interconnect-names:
    items:
      - const: cam_ahb
      - const: cam_hf_0_mnoc
      - const: cam_sf_0_mnoc

  interrupts:
    minItems: 8
    maxItems: 8

  interrupt-names:
    items:
      - const: csid0
      - const: csid1
      - const: csiphy0
      - const: csiphy1
      - const: csiphy2
      - const: csiphy3
      - const: vfe0
      - const: vfe1

  iommus:
    minItems: 8
    maxItems: 8

  power-domains:
    minItems: 3
    maxItems: 3

  power-domain-names:
    items:
      - const: ife0
      - const: ife1
      - const: top

  reg:
    minItems: 8
    maxItems: 8

  reg-names:
    items:
      - const: csid0
      - const: csid1
      - const: csiphy0
      - const: csiphy1
      - const: csiphy2
      - const: csiphy3
      - const: vfe0
      - const: vfe1

  vdda-phy-supply:
    description: 0.88 V supply for the CSI PHY core blocks.

  vdda-pll-supply:
    description: 1.2 V supply for the CSI PHY reference-clock PLL blocks.

  ports:
    $ref: /schemas/graph.yaml#/properties/ports
    description: CSI input ports, one for each CSI PHY.

    patternProperties:
      "^port@[0-3]$":
        $ref: /schemas/graph.yaml#/$defs/port-base
        unevaluatedProperties: false

        properties:
          endpoint:
            $ref: /schemas/media/video-interfaces.yaml#
            unevaluatedProperties: false

            properties:
              data-lanes:
                minItems: 1
                maxItems: 4

            required:
              - data-lanes

required:
  - clock-names
  - clocks
  - compatible
  - interconnect-names
  - interconnects
  - interrupt-names
  - interrupts
  - iommus
  - power-domain-names
  - power-domains
  - reg
  - reg-names
  - vdda-phy-supply
  - vdda-pll-supply
  - ports

additionalProperties: false
...
```

## Documentation/devicetree/bindings/power/supply/idt,p9418.yaml
```yaml
# SPDX-License-Identifier: (GPL-2.0-only OR BSD-2-Clause)
%YAML 1.2
---
$id: http://devicetree.org/schemas/power/supply/idt,p9418.yaml#
$schema: http://devicetree.org/meta-schemas/core.yaml#

title: IDT P9418 wireless power transmitter

maintainers:
  - MCC45TR <mcc45tr@users.noreply.github.com>

description: |
  IDT P9418 transmitter used by Xiaomi Pad 5 for stylus detection, reverse
  wireless charging, charge-state monitoring and stylus Bluetooth MAC
  reporting.

properties:
  compatible:
    const: idt,p9418

  reg:
    maxItems: 1

  idt,irq-gpios:
    maxItems: 1

  idt,hall3-gpios:
    maxItems: 1

  idt,hall4-gpios:
    maxItems: 1

  idt,reverse-enable-gpios:
    maxItems: 1

  idt,reverse-boost-enable-gpios:
    maxItems: 1

required:
  - compatible
  - reg
  - idt,irq-gpios
  - idt,hall3-gpios
  - idt,hall4-gpios
  - idt,reverse-enable-gpios
  - idt,reverse-boost-enable-gpios

additionalProperties: false

examples:
  - |
    #include <dt-bindings/gpio/gpio.h>

    i2c {
        #address-cells = <1>;
        #size-cells = <0>;

        wireless-power@3b {
            compatible = "idt,p9418";
            reg = <0x3b>;
            idt,irq-gpios = <&tlmm 95 GPIO_ACTIVE_HIGH>;
            idt,hall3-gpios = <&tlmm 101 GPIO_ACTIVE_HIGH>;
            idt,hall4-gpios = <&tlmm 134 GPIO_ACTIVE_HIGH>;
            idt,reverse-enable-gpios = <&tlmm 3 GPIO_ACTIVE_HIGH>;
            idt,reverse-boost-enable-gpios = <&tlmm 47 GPIO_ACTIVE_HIGH>;
        };
    };
```

## Documentation/devicetree/bindings/power/supply/lionsemi,ln8000.yaml
```yaml
# SPDX-License-Identifier: (GPL-2.0-only OR BSD-2-Clause)
%YAML 1.2
---
$id: http://devicetree.org/schemas/power/supply/lionsemi,ln8000.yaml#
$schema: http://devicetree.org/meta-schemas/core.yaml#

title: Lion Semiconductor LN8000 direct charger

maintainers:
  - SENEMOS Project <senemos@localhost>

description: |
  The LN8000 is an I2C-controlled 2:1 switched-capacitor direct charger.
  Its hardware voltage, current, temperature, watchdog and reverse-current
  protections remain enabled by the Linux driver.

properties:
  compatible:
    const: lionsemi,ln8000

  reg:
    maxItems: 1

  interrupts:
    maxItems: 1

  wakeup-source: true

  input-power-supply:
    description: TCPM power supply used to observe the negotiated USB-PD input

  switching-power-supply:
    description: Conventional charger suspended while direct charging is active

  lionsemi,battery-ovp-microvolt:
    minimum: 4000000
    maximum: 5000000

  lionsemi,battery-ovp-alarm-microvolt:
    minimum: 4000000
    maximum: 5000000

  lionsemi,input-ovp-microvolt:
    minimum: 6500000
    maximum: 13000000

  lionsemi,input-ovp-alarm-microvolt:
    minimum: 6000000
    maximum: 13000000

  lionsemi,input-ocp-microamp:
    minimum: 1000000
    maximum: 6500000

  lionsemi,input-ocp-alarm-microamp:
    minimum: 1000000
    maximum: 6500000

  lionsemi,ntc-alarm-code:
    description: Raw 10-bit NTC alarm threshold used for both bus and battery sensors
    $ref: /schemas/types.yaml#/definitions/uint32
    minimum: 0
    maximum: 1023

  lionsemi,min-input-microvolt:
    minimum: 6500000
    maximum: 12000000

  lionsemi,input-ntc-unwired:
    type: boolean
    description: |
      The board does not populate a thermistor on the LN8000 TSBUS input.
      This disables only that absent input while battery NTC, die-temperature,
      voltage, current, watchdog and reverse-current protections stay active.

  lionsemi,allow-direct-charging:
    type: boolean
    description: |
      Explicitly allows the 2:1 direct-charge path. Omit this property unless
      the platform has a validated source-contract and battery-current policy;
      without it the driver remains in standby and the conventional charger
      supplies the battery.

required:
  - compatible
  - reg
  - interrupts
  - input-power-supply
  - switching-power-supply
  - lionsemi,battery-ovp-microvolt
  - lionsemi,battery-ovp-alarm-microvolt
  - lionsemi,input-ovp-microvolt
  - lionsemi,input-ovp-alarm-microvolt
  - lionsemi,input-ocp-microamp
  - lionsemi,input-ocp-alarm-microamp
  - lionsemi,ntc-alarm-code
  - lionsemi,min-input-microvolt

additionalProperties: false

examples:
  - |
    #include <dt-bindings/interrupt-controller/arm-gic.h>

    typec: typec {
    };

    switching_charger: switching-charger {
    };

    i2c {
        #address-cells = <1>;
        #size-cells = <0>;

        charger@51 {
            compatible = "lionsemi,ln8000";
            reg = <0x51>;
            interrupts = <GIC_SPI 36 IRQ_TYPE_EDGE_FALLING>;
            input-power-supply = <&typec>;
            switching-power-supply = <&switching_charger>;
            lionsemi,battery-ovp-microvolt = <4560000>;
            lionsemi,battery-ovp-alarm-microvolt = <4525000>;
            lionsemi,input-ovp-microvolt = <13000000>;
            lionsemi,input-ovp-alarm-microvolt = <11000000>;
            lionsemi,input-ocp-microamp = <3750000>;
            lionsemi,input-ocp-alarm-microamp = <3500000>;
            lionsemi,ntc-alarm-code = <226>;
            lionsemi,min-input-microvolt = <8000000>;
            lionsemi,input-ntc-unwired;
        };
    };
...
```

## Documentation/devicetree/bindings/power/supply/qcom,pm8150b-fg.yaml
```yaml
# SPDX-License-Identifier: (GPL-2.0-only OR BSD-2-Clause)
%YAML 1.2
---
$id: http://devicetree.org/schemas/power/supply/qcom,pm8150b-fg.yaml#
$schema: http://devicetree.org/meta-schemas/core.yaml#

title: Qualcomm PM8150B fuel gauge

maintainers:
  - Senemos Nabu Kernel Team <mcc45tr@users.noreply.github.com>

allOf:
  - $ref: power-supply.yaml#

properties:
  compatible:
    const: qcom,pm8150b-fg

  reg:
    maxItems: 1

  interrupts:
    maxItems: 1

  interrupt-names:
    const: soc-delta

  monitored-battery: true

  power-supplies: true

required:
  - compatible
  - reg
  - interrupts
  - interrupt-names

additionalProperties: false

examples:
  - |
    #include <dt-bindings/interrupt-controller/irq.h>
    #include <dt-bindings/spmi/spmi.h>

    spmi {
        #address-cells = <2>;
        #size-cells = <0>;

        pmic@2 {
            compatible = "qcom,pm8150b", "qcom,spmi-pmic";
            reg = <0x2 SPMI_USID>;
            #address-cells = <1>;
            #size-cells = <0>;

            fuel-gauge@4000 {
                compatible = "qcom,pm8150b-fg";
                reg = <0x4000>;
                interrupts = <0x2 0x40 0x3 IRQ_TYPE_EDGE_RISING>;
                interrupt-names = "soc-delta";
            };
        };
    };
...
```
